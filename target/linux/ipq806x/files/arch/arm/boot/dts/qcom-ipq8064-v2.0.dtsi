#include "qcom-ipq8064.dtsi"

nss-gmac-common {
	compatible = "qcom,nss-gmac-common";
	reg = <0x03000000 0x0000FFFF 0x1bb00000 0x0000FFFF 0x00900000 0x00004000>;
	reg-names = "nss_reg_base", "qsgmii_reg_base", "clk_ctl_base";
};

nss0: nss@40000000 {
	compatible = "qcom,nss";
	qcom,low-frequency = <733000000>; /* orig value 110000000 */
	qcom,mid-frequency = <733000000>; /* orig value 550000000 */
	qcom,max-frequency = <733000000>;

	interrupts = <GIC_SPI 213 IRQ_TYPE_LEVEL_HIGH>,
		     <GIC_SPI 232 IRQ_TYPE_LEVEL_HIGH>;
	reg = <0x36000000 0x1000 0x39000000 0x10000>;
	reg-names = "nphys", "vphys";
	clocks = <&gcc NSS_CORE_CLK>, <&gcc NSSTCM_CLK_SRC>,
		 <&gcc NSSTCM_CLK>, <&rpmcc RPM_NSS_FABRIC_0_CLK>,
		 <&rpmcc RPM_NSS_FABRIC_1_CLK>;
	clock-names = "nss-core-clk", "nss-tcm-src",
		      "nss-tcm-clk", "nss-fab0-clk",
		      "nss-fab1-clk";
	resets = <&gcc UBI32_CORE1_CLKRST_CLAMP_RESET>,
		 <&gcc UBI32_CORE1_CLAMP_RESET>,
		 <&gcc UBI32_CORE1_AHB_RESET>,
		 <&gcc UBI32_CORE1_AXI_RESET>;
	reset-names = "clkrst-clamp", "clamp", "ahb", "axi";

	qcom,id = <0>;
	qcom,num-irq = <2>;
	qcom,num-queue = <2>;
	qcom,load-addr = <0x40000000>;
	qcom,turbo-frequency;

	qcom,bridge-enabled;
	qcom,gre-enabled;
	qcom,gre-redir-enabled;
	qcom,gre_tunnel_enabled;
	qcom,ipv4-enabled;
	qcom,ipv4-reasm-enabled;
	qcom,ipv6-enabled;
	qcom,ipv6-reasm-enabled;
	qcom,l2tpv2-enabled;
	qcom,map-t-enabled;
	qcom,pppoe-enabled;
	qcom,pptp-enabled;
	qcom,portid-enabled;
	qcom,shaping-enabled;
	qcom,tun6rd-enabled;
	qcom,tunipip6-enabled;
	qcom,vlan-enabled;
	qcom,wlan-dataplane-offload-enabled;
	qcom,wlanredirect-enabled;
	qcom,pxvlan-enabled;
	qcom,vxlan-enabled;
	qcom,match-enabled;
	qcom,mirror-enabled;
	qcom,rmnet-enabled;
	qcom,clmap-enabled;
};

nss-common {
	compatible = "qcom,nss-common";
	reg = <0x03000000 0x00001000>;
	reg-names = "nss_fpb_base";
	clocks = <&gcc NSS_CORE_CLK>, <&gcc NSSTCM_CLK>,
		<&rpmcc RPM_NSS_FABRIC_0_CLK>, <&rpmcc RPM_NSS_FABRIC_1_CLK>;
	clock-names = "nss_core_clk", "nss_tcm_clk",
		"nss-fab0-clk", "nss-fab1-clk";
	nss_core-supply = <&smb208_s1b>;
	nss_core_vdd_nominal = <1100000>;
	nss_core_vdd_high = <1150000>;
	nss_core_threshold_freq = <733000000>;
};

/ {
	aliases {
		serial0 = &gsbi4_serial;
	};

	chosen {
		stdout-path = "serial0:115200n8";
	};

	reserved-memory {
		#address-cells = <1>;
		#size-cells = <1>;
		ranges;

		rsvd@41200000 {
			reg = <0x41200000 0x300000>;
			no-map;
		};
	};
};

&gsbi4 {
	qcom,mode = <GSBI_PROT_I2C_UART>;
	status = "okay";

	serial@16340000 {
		status = "okay";
	};
	/*
	* The i2c device on gsbi4 should not be enabled.
	* On ipq806x designs gsbi4 i2c is meant for exclusive
	* RPM usage. Turning this on in kernel manifests as
	* i2c failure for the RPM.
	*/
};

&CPU_SPC {
	status = "okay";
};

&pcie0 {
	compatible = "qcom,pcie-ipq8064-v2";
};

&pcie1 {
	compatible = "qcom,pcie-ipq8064-v2";
};

&pcie2 {
	compatible = "qcom,pcie-ipq8064-v2";
};

&sata {
	ports-implemented = <0x1>;
};

&ss_phy_0 {
	qcom,rx-eq = <2>;
	qcom,tx-deamp_3_5db = <32>;
	qcom,mpll = <5>;
};

&ss_phy_1 {
	qcom,rx-eq = <2>;
	qcom,tx-deamp_3_5db = <32>;
	qcom,mpll = <5>;
};
